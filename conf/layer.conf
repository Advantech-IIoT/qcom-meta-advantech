## conf/layer.conf
```bitbake
# We have a conf and classes directory, add to BBPATH
BBPATH .= ":${LAYERDIR}"

# We have recipes-* directories, add to BBFILES
BBFILES += "${LAYERDIR}/recipes-*/*/*.bb \
            ${LAYERDIR}/recipes-*/*/*.bbappend"

BBFILE_COLLECTIONS += "meta-qcom-advantech"
BBFILE_PATTERN_meta-qcom-advantech = "^${LAYERDIR}/"
BBFILE_PRIORITY_meta-qcom-advantech = "16"

LAYERDEPENDS_meta-qcom-advantech = "core"
LAYERSERIES_COMPAT_meta-qcom-advantech = "kirkstone"
```

## conf/machine/adv-icam300-qcs6490.conf
```bitbake
#@TYPE: Machine
#@NAME: adv-icam300-qcs6490
#@DESCRIPTION: Machine configuration for Advantech board with QCS6490
# reference from qcs6490-rb3gen2-vision-kit.conf

require conf/machine/include/qcom-qcs6490.inc

# assign machine arch to download qualcomm prebuild binary ex: fastrpc
MACHINE_ARCH = "qcs6490_rb3gen2_vision_kit"

MACHINE_FEATURES = "usbhost usbgadget alsa wifi bluetooth"

# This DT currently exist only as patches against linux-qcom-base recipe.
KERNEL_DEVICETREE:pn-linux-qcom-base = " \
                      qcom/qcs6490-rb3gen2.dtb \
                      "

KERNEL_DEVICETREE:pn-linux-qcom-custom = " \
                      qcom/qcs6490-addons-rb3gen2-video-mezz.dtb \
                      qcom/qcs6490-addons-rb3gen2-vision-mezz.dtb \
                      "

# Additional dtbo to overylay on top of kernel devicetree files
KERNEL_TECH_DTBOS[qcs6490-addons-rb3gen2-video-mezz] = " \
    qcm6490-graphics.dtbo qcm6490-camera-rb3.dtbo \
    qcm6490-display-rb3-lvds.dtbo \
    qcm6490-video.dtbo \
    "
KERNEL_TECH_DTBOS[qcs6490-addons-rb3gen2-vision-mezz] = " \
    qcm6490-graphics.dtbo qcm6490-camera-rb3.dtbo \
    qcm6490-display-rb3.dtbo \
    qcm6490-video.dtbo \
    "

# Recipe providers of above dtbo files.
KERNEL_TECH_DTBO_PROVIDERS = "\
    cameradtb \
    qcom-displaydevicetree \
    qcom-graphicsdevicetree \
    qcom-videodtb \
"
```
